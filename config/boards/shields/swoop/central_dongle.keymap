/*
 * Copyright (c) 2020 duckyb
 *
 * SPDX-License-Identifier: MIT
 */

#include <behaviors.dtsi>
#include <dt-bindings/zmk/keys.h>

#define L0 0
#define L1 1

/ {
    keymap {
        compatible = "zmk,keymap";
        base_layer {
            label = "BASE_DGL";
            bindings = <
&to L1
            >;
        };
        
        raise_layer {
            label = "RAISE_DGL";
            bindings = <
&to L0
            >;
        };
    };
};
## boards/shields/swoop/Kconfig.shield
```kconfig
# Copyright (c) 2022 Duccio Breschi
# SPDX-License-Identifier: MIT

config SHIELD_CENTRAL_DONGLE
    def_bool $(shields_list_contains,central_dongle)

config SHIELD_SWOOP_LEFT
    def_bool $(shields_list_contains,swoop_left)

config SHIELD_SWOOP_RIGHT
    def_bool $(shields_list_contains,swoop_right)
```

## config/boards/shields/central_dongle/Kconfig.defconfig
```kconfig
config ZMK_KEYBOARD_NAME
    default "ST7789V"

config ZMK_SPLIT_ROLE_CENTRAL
    default y

choice ZMK_DISPLAY_STATUS_SCREEN
    default ZMK_DISPLAY_STATUS_SCREEN_CUSTOM
endchoice

config ZMK_DISPLAY_STATUS_SCREEN_CUSTOM
    select ZMK_WPM
    imply ZMK_HID_INDICATORS

choice ZMK_DISPLAY_WORK_QUEUE
    default ZMK_DISPLAY_WORK_QUEUE_DEDICATED
endchoice

config LV_Z_VDB_SIZE
	default 64
    
config LV_DPI_DEF
    default 148

config LV_Z_BITS_PER_PIXEL
    default 16

choice ST7789V_PIXEL_FORMAT
    default ST7789V_RGB565
endchoice

choice LV_COLOR_DEPTH
    default LV_COLOR_DEPTH_16
endchoice
```

## config/boards/shields/snake_dongle/Kconfig.shield
```kconfig
# Copyright (c) 2022 Duccio Breschi
# SPDX-License-Identifier: MIT

config SHIELD_SNAKE_DONGLE
    def_bool $(shields_list_contains,snake_dongle)
```

## config/boards/shields/swoop/Kconfig.shield
```kconfig
# Copyright (c) 2022 Duccio Breschi
# SPDX-License-Identifier: MIT

config SHIELD_SWOOP_LEFT
    def_bool $(shields_list_contains,swoop_left)

config SHIELD_SWOOP_RIGHT
    def_bool $(shields_list_contains,swoop_right)
```

## config/west.yml
```yaml
manifest:
  remotes:
    - name: zmkfirmware
      url-base: https://github.com/zmkfirmware
  projects:
    - name: zmk
      remote: zmkfirmware
      revision: main
      import: app/west.yml
    - name: zmk-module-xiaord
      url: https://github.com/TakeshiAkehi/zmk-module-xiaord.git
      revision: main
  self:
    path: config
```
